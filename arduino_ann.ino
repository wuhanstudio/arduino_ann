#include <stdlib.h>
#include "genann.h"

const int samples = 150;

const double myclass[][3] = {
  {1.000000, 0.000000, 0.000000},
  {1.000000, 0.000000, 0.000000},
  {1.000000, 0.000000, 0.000000},
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  {0.000000, 0.000000, 1.000000},
};

const double input[][4] = {
  {5.100000, 3.500000, 1.400000, 0.200000},
  {4.900000, 3.000000, 1.400000, 0.200000},
  {4.700000, 3.200000, 1.300000, 0.200000},
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  {5.900000, 3.000000, 5.100000, 1.800000},
};

void setup()
{
  Serial.begin(115200);
  int i, j;
  int loops = 500;

  /* Train the network with backpropagation. */
  genann *ann = genann_init(4, 1, 4, 3);
  Serial.println("Training for 500 loops over data.");
  unsigned long start_time = millis();
  for (i = 0; i < loops; ++i) {
    for (j = 0; j < samples; ++j) {
      genann_train(ann, input[j], myclass[j], .01);
    }
    if (i % 10 == 0) {
      Serial.print("Training Loop ");
      Serial.print(i);
      Serial.println();
    }
  }
  Serial.print("Training time ");
  Serial.print(millis() - start_time);
  Serial.println(" ms");

  /* Predict result with trained model*/
  int correct = 0;
  start_time = millis();
  for (j = 0; j < samples; ++j) {
    const double *guess = genann_run(ann, input[j]);
    if (myclass[j][0] == 1.0) {
      if (guess[0] > guess[1] && guess[0] > guess[2]) ++correct;
    }
    else if (myclass[j][1] == 1.0) {
      if (guess[1] > guess[0] && guess[1] > guess[2]) ++correct;
    }
    else if (myclass[j][2] == 1.0) {
      if (guess[2] > guess[0] && guess[2] > guess[1]) ++correct;
    }
    else {
      Serial.println("Logic error.\n");
    }
  }
  Serial.print("Predicting time ");
  Serial.print(millis() - start_time);
  Serial.println(" ms");
  // Print results
  Serial.print((int)correct * 100 / samples);

  genann_free(ann);
}

void loop()
{

}
